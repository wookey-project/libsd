## Kconfig
```kconfig
config USR_LIB_SD
  bool  "userspace libsd for SDCard support"
  default y
  select USR_DRV_SDIO
  ---help---
  Support for SDCard hardware-independent protocol implementation.
  This lib depends on the sdio driver, which manage the HW IP.

if USR_LIB_SD

menu "SD options"

config USR_LIB_SD_DEBUG
  bool "Activate libSD debugging informations"
  default n

endmenu

endif
```
